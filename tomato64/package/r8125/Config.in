## tomato64/package/r8125/Config.in
```kconfig
config BR2_PACKAGE_R8125
	bool "r8125"
	depends on BR2_PACKAGE_PLATFORM_R76S
	help
	  Realtek RTL8125 2.5GbE PCIe Linux vendor driver
	  (out-of-tree replacement for the in-kernel r8169 driver on
	  RTL8125-family NICs, used on the NanoPi R76S).
```

## tomato64/package/rc/Config.in
```kconfig
menuconfig BR2_PACKAGE_RC
	bool "rc"
	select BR2_PACKAGE_LIBNVRAM
	select BR2_PACKAGE_NVRAM
	select BR2_PACKAGE_LIBSHARED
	select BR2_PACKAGE_HTTPD
	select BR2_PACKAGE_RSTATS
	select BR2_PACKAGE_CSTATS
	select BR2_PACKAGE_WANUPTIME
	select BR2_PACKAGE_ROM
	select BR2_PACKAGE_OTHERS
	select BR2_PACKAGE_WWW
	select BR2_PACKAGE_DNSMASQ
	select BR2_PACKAGE_DNSMASQ_TFTP
	select BR2_PACKAGE_DNSMASQ_DHCP
	select BR2_PACKAGE_DNSMASQ_CONNTRACK
	select BR2_PACKAGE_DNSMASQ_DNSSEC
	select BR2_PACKAGE_DNSMASQ_IDN
	select BR2_PACKAGE_DNSMASQ_CONNTRACK
	select BR2_PACKAGE_IPSET_TOMATO
	select BR2_PACKAGE_IPROUTE2
	select BR2_PACKAGE_IPTABLES
	select BR2_PACKAGE_MINIUPNPD
	select BR2_PACKAGE_BRIDGE_UTILS
	select BR2_PACKAGE_HOTPLUG2
	select BR2_PACKAGE_TRACEROUTE
	select BR2_PACKAGE_RP_PPPOE_TOMATO
	select BR2_PACKAGE_LIBOPENSSL_BIN
	select BR2_PACKAGE_LIBOPENSSL_ENGINES
	select BR2_PACKAGE_LIBCURL
	select BR2_PACKAGE_LIBCURL_CURL
	select BR2_PACKAGE_E2FSPROGS
	select BR2_PACKAGE_E2FSPROGS_FSCK
	select BR2_PACKAGE_E2FSPROGS_RESIZE2FS
	select BR2_PACKAGE_GPTFDISK
	select BR2_PACKAGE_GPTFDISK_GDISK
	select BR2_PACKAGE_GPTFDISK_SGDISK
	select BR2_PACKAGE_GPTFDISK_CGDISK
	select BR2_PACKAGE_QEMU
	select BR2_PACKAGE_QEMU_GUEST_AGENT
	select BR2_PACKAGE_DMIDECODE
	select BR2_PACKAGE_VIRT_WHAT
	select BR2_PACKAGE_TTYD
	select BR2_PACKAGE_ETHTOOL
	select BR2_PACKAGE_HOST_DOSFSTOOLS
	select BR2_PACKAGE_HOST_GENIMAGE
	select BR2_PACKAGE_HOST_MTOOLS
	help
	  rc is the init process for Tomato.

if BR2_PACKAGE_RC

config BR2_PACKAGE_RC_BT
	bool "Enable Bittorrent"
	default y
	select BR2_PACKAGE_TRANSMISSION
	select BR2_PACKAGE_TRANSMISSION_UTP
	select BR2_PACKAGE_TRANSMISSION_CLI
	select BR2_PACKAGE_TRANSMISSION_DAEMON

config BR2_PACKAGE_RC_CIFS
	bool "Enable CIFS"
	default y

config BR2_PACKAGE_RC_DDNS
	bool "Enable DDNS"
	default y
	select BR2_PACKAGE_MDU

config BR2_PACKAGE_RC_DNSCRYPT
	bool "Enable DNSCRYPT"
	default y
	select BR2_PACKAGE_DNSCRYPT_PROXY

config BR2_PACKAGE_RC_DNSSEC
	bool "Enable DNSSEC"
	default y

config BR2_PACKAGE_RC_EBTABLES
	bool "Enable Ebtables"
	default y
	select BR2_PACKAGE_EBTABLES

config BR2_PACKAGE_RC_FTP
	bool "Enable FTP"
	default y
	select BR2_PACKAGE_VSFTPD_TOMATO

if BR2_PACKAGE_RC_FTP
config BR2_PACKAGE_RC_FTPS
	bool "Enable FTPS"
	default y
	select BR2_PACKAGE_OPENSSL
endif

config BR2_PACKAGE_RC_HTTPS
	bool "Enable HTTPS"
	default y

config BR2_PACKAGE_RC_IPERF
	bool "Enable IPERF"
	default y
	select BR2_PACKAGE_IPERF3

config BR2_PACKAGE_RC_IPV6
	bool "Enable IPv6"
	default y
	select BR2_PACKAGE_DHCPV6_TOMATO

config BR2_PACKAGE_RC_IRQBALANCE
	bool "Enable IRQBALANCE"
	default y
	select BR2_PACKAGE_IRQBALANCE

config BR2_PACKAGE_RC_L2TP
	bool "Enable L2TP"
	default y
	select BR2_PACKAGE_XL2TP

config BR2_PACKAGE_RC_MDNS
	bool "Enable MDNS"
	default y
	select BR2_PACKAGE_AVAHI_TOMATO

config BR2_PACKAGE_RC_MEDIA_SERVER
	bool "Enable Media Server"
	default y
	select BR2_PACKAGE_MINIDLNA_TOMATO

config BR2_PACKAGE_RC_MULTIWAN
	bool "Enable MultiWan"
	default y

config BR2_PACKAGE_RC_NANO
	bool "Enable Nano"
	default y
	select BR2_PACKAGE_NANO

config BR2_PACKAGE_RC_NFS
	bool "Enable NFS"
	default y
	select BR2_PACKAGE_NFS_UTILS
	select BR2_PACKAGE_NFS_UTILS_RPC_NFSD

config BR2_PACKAGE_RC_NGINX
	bool "Enable NGINX"
	default y
	select BR2_PACKAGE_NGINX_TOMATO
	select BR2_PACKAGE_NGINX_TOMATO_HTTP
	select BR2_PACKAGE_NGINX_TOMATO_HTTP_CACHE
	select BR2_PACKAGE_NGINX_TOMATO_HTTP_SSL_MODULE
	select BR2_PACKAGE_NGINX_TOMATO_HTTP_V2_MODULE
	select BR2_PACKAGE_NGINX_TOMATO_HTTP_REALIP_MODULE
	select BR2_PACKAGE_NGINX_TOMATO_HTTP_FLV_MODULE
	select BR2_PACKAGE_NGINX_TOMATO_HTTP_GZIP_STATIC_MODULE
	select BR2_PACKAGE_NGINX_TOMATO_HTTP_GZIP_MODULE
	select BR2_PACKAGE_NGINX_TOMATO_HTTP_REWRITE_MODULE
	select BR2_PACKAGE_NGINX_TOMATO_HTTP_CHARSET_MODULE
	select BR2_PACKAGE_NGINX_TOMATO_HTTP_SSI_MODULE
	select BR2_PACKAGE_NGINX_TOMATO_HTTP_USERID_MODULE
	select BR2_PACKAGE_NGINX_TOMATO_HTTP_ACCESS_MODULE
	select BR2_PACKAGE_NGINX_TOMATO_HTTP_AUTH_BASIC_MODULE
	select BR2_PACKAGE_NGINX_TOMATO_HTTP_AUTOINDEX_MODULE
	select BR2_PACKAGE_NGINX_TOMATO_HTTP_GEO_MODULE
	select BR2_PACKAGE_NGINX_TOMATO_HTTP_MAP_MODULE
	select BR2_PACKAGE_NGINX_TOMATO_HTTP_SPLIT_CLIENTS_MODULE
	select BR2_PACKAGE_NGINX_TOMATO_HTTP_REFERER_MODULE
	select BR2_PACKAGE_NGINX_TOMATO_HTTP_PROXY_MODULE
	select BR2_PACKAGE_NGINX_TOMATO_HTTP_FASTCGI_MODULE
	select BR2_PACKAGE_NGINX_TOMATO_HTTP_UWSGI_MODULE
	select BR2_PACKAGE_NGINX_TOMATO_HTTP_SCGI_MODULE
	select BR2_PACKAGE_NGINX_TOMATO_HTTP_MEMCACHED_MODULE
	select BR2_PACKAGE_NGINX_TOMATO_HTTP_LIMIT_CONN_MODULE
	select BR2_PACKAGE_NGINX_TOMATO_HTTP_LIMIT_REQ_MODULE
	select BR2_PACKAGE_NGINX_TOMATO_HTTP_EMPTY_GIF_MODULE
	select BR2_PACKAGE_NGINX_TOMATO_HTTP_BROWSER_MODULE
	select BR2_PACKAGE_NGINX_TOMATO_HTTP_UPSTREAM_IP_HASH_MODULE
	select BR2_PACKAGE_NGINX_TOMATO_HTTP_UPSTREAM_LEAST_CONN_MODULE
	select BR2_PACKAGE_NGINX_TOMATO_HTTP_UPSTREAM_RANDOM_MODULE
	select BR2_PACKAGE_NGINX_TOMATO_HTTP_UPSTREAM_KEEPALIVE_MODULE
	select BR2_PACKAGE_NGINX_TOMATO_HTTP_UPSTREAM_ZONE_MODULE

	select BR2_PACKAGE_PHP_TOMATO
	select BR2_PACKAGE_PHP_TOMATO_EXT_ZLIB
	select BR2_PACKAGE_PHP_TOMATO_EXT_POSIX
	select BR2_PACKAGE_PHP_TOMATO_EXT_SESSION
	select BR2_PACKAGE_PHP_TOMATO_SAPI_CGI
	select BR2_PACKAGE_PHP_TOMATO_SAPI_CLI
	select BR2_PACKAGE_PHP_TOMATO_EXT_FILEINFO
	select BR2_PACKAGE_PHP_TOMATO_EXT_FILTER
	select BR2_PACKAGE_PHP_TOMATO_EXT_ZIP
	select BR2_PACKAGE_PHP_TOMATO_EXT_MYSQLI
	select BR2_PACKAGE_PHP_TOMATO_EXT_SQLITE
	select BR2_PACKAGE_PHP_TOMATO_EXT_PDO
	select BR2_PACKAGE_PHP_TOMATO_EXT_PDO_MYSQL
	select BR2_PACKAGE_PHP_TOMATO_EXT_PDO_SQLITE
	select BR2_PACKAGE_PHP_TOMATO_EXT_ICONV
	select BR2_PACKAGE_PHP_TOMATO_EXT_MBSTRING
	select BR2_PACKAGE_PHP_TOMATO_EXT_EXIF
	select BR2_PACKAGE_PHP_TOMATO_EXT_GD
	select BR2_PACKAGE_PHP_TOMATO_EXT_CURL
	select BR2_PACKAGE_PHP_TOMATO_EXT_CTYPE
	select BR2_PACKAGE_PHP_TOMATO_EXT_DOM
	select BR2_PACKAGE_PHP_TOMATO_EXT_SIMPLEXML
	select BR2_PACKAGE_PHP_TOMATO_EXT_XML
	select BR2_PACKAGE_PHP_TOMATO_EXT_XMLREADER
	select BR2_PACKAGE_PHP_TOMATO_EXT_XMLWRITER

	select BR2_PACKAGE_SPAWN_FCGI

	select BR2_PACKAGE_MYSQL
	select BR2_PACKAGE_MARIADB
	select BR2_PACKAGE_MARIADB_SERVER
	select BR2_PACKAGE_MARIADB_SERVER_EMBEDDED

config BR2_PACKAGE_RC_NOCAT
	bool "Enable NOCAT"
	default y

config BR2_PACKAGE_RC_NTFS
	bool "Enable NTFS"
	default y
	select BR2_PACKAGE_NTFS_3G
	select BR2_PACKAGE_NTFS_3G_NTFSPROGS

config BR2_PACKAGE_RC_OPENVPN
	bool "Enable OpenVPN"
	default y
	select BR2_PACKAGE_OPENVPN
	select BR2_PACKAGE_OPENVPN_LZO
	select BR2_PACKAGE_OPENVPN_LZ4

config BR2_PACKAGE_RC_PPTP
	bool "Enable PPTP"
	default y
	select BR2_PACKAGE_ACCEL_PPTP

config BR2_PACKAGE_RC_PPTPD
	bool "Enable PPTPD"
	default y
	select BR2_PACKAGE_PPTPD

config BR2_PACKAGE_RC_PROXY
	bool "Enable udpxy and igmpproxy"
	default y
	select BR2_PACKAGE_UDPXY
	select BR2_PACKAGE_IGMPPROXY

config BR2_PACKAGE_RC_SAMBA
	bool "Enable Samba"
	default y
	select BR2_PACKAGE_SAMBA4_TOMATO
	select BR2_PACKAGE_WSDD2

config BR2_PACKAGE_RC_SNMP
	bool "Enable SNMP"
	default y
	select BR2_PACKAGE_NETSNMP_TOMATO

config BR2_PACKAGE_RC_SSH
	bool "Enable SSH"
	default y
	select BR2_PACKAGE_DROPBEAR
	select BR2_PACKAGE_DROPBEAR_CLIENT

config BR2_PACKAGE_RC_STUBBY
	bool "Enable Stubby"
	default y
	select BR2_PACKAGE_STUBBY

config BR2_PACKAGE_RC_TINC
	bool "Enable Tinc VPN"
	default y
	select BR2_PACKAGE_TINC11

config BR2_PACKAGE_RC_TOR
	bool "Enable Tor"
	default y
	select BR2_PACKAGE_TOR

config BR2_PACKAGE_RC_UPS
	bool "Enable UPS"
	default y
	select BR2_PACKAGE_APCUPSD
	select BR2_PACKAGE_APCUPSD_APCSMART
	select BR2_PACKAGE_APCUPSD_DUMB
	select BR2_PACKAGE_APCUPSD_MODBUS
	select BR2_PACKAGE_APCUPSD_MODBUS_USB
	select BR2_PACKAGE_APCUPSD_NET
	select BR2_PACKAGE_APCUPSD_PCNET
	select BR2_PACKAGE_APCUPSD_SNMP
	select BR2_PACKAGE_APCUPSD_USB

config BR2_PACKAGE_RC_USB
	bool "Enable USB"
	default y
	select BR2_PACKAGE_P910ND
	select BR2_PACKAGE_COMGT_TOMATO
	select BR2_PACKAGE_UQMI

config BR2_PACKAGE_RC_WIREGUARD
	bool "Enable Wireguard"
	default y
	select BR2_PACKAGE_WIREGUARD_TOOLS

config BR2_PACKAGE_RC_ZFS
	bool "Enable ZFS"
	default y
	select BR2_PACKAGE_ZFS_TOMATO

comment "Debugging"

config BR2_PACKAGE_RC_DEBUG
	bool "Enable Debug to Console"
	default y
endif
```

## tomato64/package/relayd/Config.in
```kconfig
config BR2_PACKAGE_RELAYD
	bool "relayd"
	select BR2_PACKAGE_LIBUBOX
	help
	  IPv4 pseudo-bridge routing daemon
```

## tomato64/package/rom/Config.in
```kconfig
config BR2_PACKAGE_ROM
	bool "rom"
	select BR2_PACKAGE_LIBSHARED
	select BR2_PACKAGE_HOST_UTIL_LINUX
	help
	  Populates /etc
```

## tomato64/package/rstats/Config.in
```kconfig
config BR2_PACKAGE_RSTATS
	bool "bandwidth monitoring"
	select BR2_PACKAGE_LIBSHARED
	select BR2_PACKAGE_ZLIB
	help
	  Monitors all bandwidth going through the router.
```

## tomato64/package/samba4-tomato/Config.in
```kconfig
comment "samba4 needs a uClibc or glibc toolchain w/ wchar, dynamic library, NPTL"
	depends on BR2_TOOLCHAIN_HAS_SYNC_4
	depends on !BR2_USE_WCHAR \
		|| BR2_STATIC_LIBS || !BR2_TOOLCHAIN_HAS_THREADS_NPTL
	depends on BR2_USE_MMU

config BR2_PACKAGE_SAMBA4_TOMATO
	bool "samba4"
	depends on BR2_USE_MMU # fork()
	depends on BR2_USE_WCHAR # python
	depends on BR2_TOOLCHAIN_HAS_THREADS_NPTL # python -> libffi
	depends on !BR2_STATIC_LIBS # cmocka, python, gnutls
	depends on !BR2_nios2 # binary too large, relocations don't fit
	depends on BR2_TOOLCHAIN_HAS_SYNC_4
	select BR2_PACKAGE_CMOCKA
	select BR2_PACKAGE_E2FSPROGS
	select BR2_PACKAGE_GNUTLS
	select BR2_PACKAGE_HOST_PYTHON3
	select BR2_PACKAGE_HOST_PYTHON3_SSL
	select BR2_PACKAGE_LIBICONV if !BR2_ENABLE_LOCALE
	select BR2_PACKAGE_LIBTIRPC if !BR2_TOOLCHAIN_HAS_NATIVE_RPC
	select BR2_PACKAGE_LIBXCRYPT if BR2_TOOLCHAIN_USES_GLIBC
	select BR2_PACKAGE_POPT
	select BR2_PACKAGE_ZLIB
	help
	  Provides secure, stable and fast file and print services
	  for all clients using the SMB/CIFS protocol, such as all
	  versions of DOS, Windows, OS/2, Linux and many others.

	  http://www.samba.org/
```

## tomato64/package/sd-idle/Config.in
```kconfig
config BR2_PACKAGE_SD_IDLE
	bool "sd-idle"
	help
	   This program manages devices /dev/sdX 'a'<=X<='z' watching for idleness
	   and spinning them down.
```

## tomato64/package/skeleton-init-rc/Config.in
```kconfig
config BR2_PACKAGE_SKELETON_INIT_RC
	bool
	select BR2_PACKAGE_HAS_SKELETON

config BR2_PACKAGE_PROVIDES_SKELETON
	default "skeleton-init-rc" if BR2_PACKAGE_SKELETON_INIT_RC
```

## tomato64/package/stubby/Config.in
```kconfig
config BR2_PACKAGE_STUBBY
	bool "stubby"
	select BR2_PACKAGE_LIBYAML
	help
	  Stubby
```

## tomato64/package/t64up/Config.in
```kconfig
config BR2_PACKAGE_T64UP
	bool "t64up"
	depends on BR2_x86_64
	help
	  Tomato64 Upgrade Script
```

## tomato64/package/tinc11/Config.in
```kconfig
config BR2_PACKAGE_TINC11
	bool "tinc-1.1"
	depends on !BR2_STATIC_LIBS # tinc-1.1 requires libdl for OpenSSL
	depends on BR2_USE_MMU # fork()
	select BR2_PACKAGE_LZO
	select BR2_PACKAGE_OPENSSL
	select BR2_PACKAGE_ZLIB
	select BR2_PACKAGE_LZ4
	help
	  tinc-1.1 is a Virtual Private Network (VPN) daemon that uses
	  tunnelling and encryption to create a secure private network
	  between hosts on the Internet.

	  http://www.tinc-vpn.org/

comment "tinc-1.1 needs a toolchain w/ dynamic library"
	depends on BR2_STATIC_LIBS
```

## tomato64/package/tomato64-helper-scripts/Config.in
```kconfig
config BR2_PACKAGE_TOMATO64_HELPER_SCRIPTS
	bool "tomato64-helper-scripts"
	help
	  tomato64 helper scripts
```

## tomato64/package/ubi-utils-openwrt/Config.in
```kconfig
config BR2_PACKAGE_UBI_UTILS_OPENWRT
	bool "ubi-utils-openwrt"
	select BR2_PACKAGE_UTIL_LINUX
	select BR2_PACKAGE_UTIL_LINUX_LIBUUID
	help
	  OpenWrt's UBI userspace utilities (mtd-utils ubi-utils, version
	  pinned to the release OpenWrt ships) for KERNEL_IN_UBI sysupgrade
	  on SPI-NAND devices.
```

## tomato64/package/ucode/Config.in
```kconfig
config BR2_PACKAGE_UCODE
	bool "ucode"
	select BR2_PACKAGE_LIBUBOX
	select BR2_PACKAGE_UBUS
	select BR2_PACKAGE_LIBUCI
	select BR2_PACKAGE_LIBNL_TINY
	select BR2_PACKAGE_LIBMD
	help
	  The ucode language is a small, general-purpose scripting language that resembles ECMAScript syntax.
```

## tomato64/package/udebug/Config.in
```kconfig
config BR2_PACKAGE_UDEBUG
	bool "udebug"
	select BR2_PACKAGE_UBUS
	help
	  The ucode language is a small, general-purpose scripting language that resembles ECMAScript syntax.
```

## tomato64/package/virt-what/Config.in
```kconfig
config BR2_PACKAGE_VIRT_WHAT
	bool "virt-what"
	help
	  detect if we are running in a virtual machine
```

## tomato64/package/wanuptime/Config.in
```kconfig
config BR2_PACKAGE_WANUPTIME
	bool "wanuptime"
	select BR2_PACKAGE_LIBSHARED
	help
	  Gives WAN uptime in seconds.
```

## tomato64/package/wg-quick-posix/Config.in
```kconfig
config BR2_PACKAGE_WG_QUICK_POSIX
	bool "wg-quick-posix"
	help
	  posix compliant version of wg-quick shell script.
```

## tomato64/package/wireless-regdb-openwrt/Config.in
```kconfig
config BR2_PACKAGE_WIRELESS_REGDB_OPENWRT
	bool "wireless-regdb-openwrt"
	select BR2_PACKAGE_HOST_PYTHON3
	help
	  Wireless regulatory database compiled from source.
	  Uses OpenWrt's build method with patched 5GHz rules.
```

## tomato64/package/wsdd2/Config.in
```kconfig
config BR2_PACKAGE_WSDD2
	bool "wsdd2"
	help
	  WSD/LLMNR Discovery/Name Service Daemon
```

## tomato64/package/www/Config.in
```kconfig
config BR2_PACKAGE_WWW
	bool "www"
	select BR2_PACKAGE_LIBSHARED
	help
	  Tomato web pages
```
