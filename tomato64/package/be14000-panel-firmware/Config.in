## tomato64/package/be14000-panel-firmware/Config.in
```kconfig
config BR2_PACKAGE_BE14000_PANEL_FIRMWARE
	bool "be14000-panel-firmware"
	help
	  panel-mipi-dbi init command sequence for the Sitronix ST7789P3
	  LCD behind the GL.iNet GL-BE14000's front panel.

	  The DRM panel driver knows no panel of its own: it resets the
	  controller and replays this sequence, read from
	  /lib/firmware/<compatible>.bin, every time the display pipeline
	  is enabled. Without it the panel probes and stays dark.

	  Regenerate the blob with gen-panel-fw.py in this directory.
```

## tomato64/package/bridger/Config.in
```kconfig
config BR2_PACKAGE_BRIDGER
	bool "bridger"
	depends on BR2_TOOLCHAIN_HAS_SYNC_4 # libbpf
	depends on BR2_USE_WCHAR # libbpf -> elfutils
	depends on !BR2_STATIC_LIBS # libbpf -> elfutils
	depends on BR2_TOOLCHAIN_HAS_THREADS # libbpf -> elfutils
	select BR2_PACKAGE_LIBBPF
	select BR2_PACKAGE_LIBUBOX
	select BR2_PACKAGE_LIBNL_TINY
	help
	  Bridge forwarding accelerator. A daemon plus an eBPF tc
	  classifier that takes established flows between members of
	  a bridge out of the kernel bridge path, and installs them
	  in hardware where the ethernet driver supports it (the
	  MediaTek PPE, and WED for WiFi).

	  https://github.com/nbd168/bridger
```

## tomato64/package/broadcom-wl/Config.in
```kconfig
config BR2_PACKAGE_BROADCOM_WL
	bool "broadcom-wl"
	depends on BR2_PACKAGE_PLATFORM_BCM53XX
	select BR2_PACKAGE_LIBSHARED
	select BR2_PACKAGE_LIBNVRAM
	help
	  Broadcom's wl WiFi driver and its userspace tools,
	  for Northstar (BCM4708/4709) hardware.

	  Builds wl.ko by linking FreshTomato's wl_apsta.o - a blob compiled
	  against Linux 2.6.36 - against a shadow-struct translation layer that
	  presents it 2.6.36 struct layouts on a 6.12 kernel. Also builds the
	  userspace side the driver needs: wlconf (radio configuration through
	  the driver's private ioctls), eapd and nas (WPA), and wldiag.

	  These radios have no open-source driver: b43's AC-PHY support is
	  "depends on BROKEN" and brcmfmac only handles fullmac parts.
```

## tomato64/package/cst353x/Config.in
```kconfig
config BR2_PACKAGE_CST353X
	bool "cst353x"
	depends on BR2_LINUX_KERNEL
	help
	  Driver for the Hynitron CST353X capacitive touch controller
	  fitted behind the GL.iNet GL-BE14000's front-panel LCD.

	  Builds cst353x.ko and enables evdev so touches appear on
	  /dev/input/eventN. MODULE_STRIPPED means no modalias
	  autoload, so set_devs_be14000 loads it explicitly.
```

## tomato64/package/ctf/Config.in
```kconfig
config BR2_PACKAGE_CTF
	bool "ctf"
	depends on BR2_LINUX_KERNEL
	depends on BR2_PACKAGE_PLATFORM_BCM53XX
	help
	  Cut-through forwarding for bgmac: an open-source take on
	  Broadcom's CTF for Northstar (BCM4708/4709) routers.

	  Builds ctf.ko, which makes bgmac a netfilter flowtable
	  "hardware" offload target. Flows the flowtable offloads are
	  forwarded straight from bgmac's receive path, skipping GRO,
	  the DSA receive path, RPS and the netfilter ingress hook.
	  Selected with "Hardware flow offloading" in the web UI.

	  Needs the bgmac offload hook, which the bcm53xx kernel
	  carries as linux-patches/00003-bgmac-offload-hook.patch.

	  https://github.com/tomato64/ctf
```

## tomato64/package/gargoyle-bandwidth/Config.in
```kconfig
config BR2_PACKAGE_GARGOYLE_BANDWIDTH
	bool "gargoyle-bandwidth"
	depends on BR2_LINUX_KERNEL
	select BR2_PACKAGE_IPTABLES
	help
	  Gargoyle xt_bandwidth netfilter match.

	  Builds the libxt_bandwidth.so iptables/ip6tables extension and
	  enables CONFIG_NETFILTER_XT_BANDWIDTH, so the xt_bandwidth module
	  (patched into the kernel by 0007-xt-bandwidth.patch) is built too.

	  The match does efficient in-kernel per-id / per-IP byte accounting
	  and is the foundation for Gargoyle-style bandwidth monitoring and
	  quotas.

	  Originally from Gargoyle router firmware (gargoyle-router.com).

comment "gargoyle-bandwidth needs a Linux kernel to be built"
	depends on !BR2_LINUX_KERNEL
```

## tomato64/package/gargoyle-quotas/Config.in
```kconfig
config BR2_PACKAGE_GARGOYLE_QUOTAS
	bool "gargoyle-quotas"
	select BR2_PACKAGE_GARGOYLE_BANDWIDTH
	help
	  Userspace support for bandwidth quotas.

	  Builds libiptbwctl, the library that talks to the xt_bandwidth
	  match over its get/setsockopt interface, and quota_backup, which
	  persists quota usage counters across reboots (they otherwise live
	  only in kernel memory).

	  The quota rules themselves are generated by rc; this package only
	  provides the counter plumbing.

	  Originally from Gargoyle router firmware (gargoyle-router.com).
```

## tomato64/package/gargoyle-timerange/Config.in
```kconfig
config BR2_PACKAGE_GARGOYLE_TIMERANGE
	bool "gargoyle-timerange"
	depends on BR2_LINUX_KERNEL
	select BR2_PACKAGE_IPTABLES
	help
	  Gargoyle xt_timerange netfilter match.

	  Builds the libxt_timerange.so iptables/ip6tables extension and
	  enables CONFIG_NETFILTER_XT_TIMERANGE, so the xt_timerange module
	  (patched into the kernel by 0008-xt-timerange.patch) is built too.

	  The match tests packets against hours-of-day, days-of-week and
	  weekly time ranges; it is used by Gargoyle to make bandwidth quotas
	  active only during chosen on-peak / off-peak windows.

	  Originally from Gargoyle router firmware (gargoyle-router.com).

comment "gargoyle-timerange needs a Linux kernel to be built"
	depends on !BR2_LINUX_KERNEL
```

## tomato64/package/glinet-panel-ui/Config.in
```kconfig
config BR2_PACKAGE_GLINET_PANEL_UI
	bool "glinet-panel-ui"
	select BR2_PACKAGE_UCODE_MOD_LVGL
	select BR2_PACKAGE_LIBUCI
	help
	  The front-panel interface for the GL.iNet BE10000 and BE14000:
	  a 320x240 DRM display with a capacitive touchscreen, written in
	  ucode against ucode-mod-lvgl.

	  An idle clock, then pages the user swipes between: traffic,
	  wireless, the networks and their switches, the radios, QR codes
	  to join them, the clients, the interfaces, the ports, the
	  system gauges, brightness and reboot.

	  Start it with /usr/bin/panel_ui.

	  https://github.com/blogic/glinet-panel-ui
```

## tomato64/package/libnvram/Config.in
```kconfig
config BR2_PACKAGE_LIBNVRAM
	bool "libnvram"
	help
	  libnvram retrives and stored key-value pairs for router configuration

if BR2_PACKAGE_LIBNVRAM

choice
	prompt "libnvram implementation"
	default BR2_PACKAGE_LIBNVRAM_RS
	help
	  Which implementation provides /usr/lib/libnvram.so. Both are ABI
	  compatible; nothing else in the tree needs to change to switch,
	  because packages depend on the virtual "libnvram".

config BR2_PACKAGE_LIBNVRAM_C
	bool "C (firmadyne-derived)"
	select BR2_PACKAGE_HAS_LIBNVRAM
	help
	  The original C implementation, kept as a fallback. Stores one
	  file per key under /nvram and writes through to disk on every
	  nvram_set().

config BR2_PACKAGE_LIBNVRAM_RS
	bool "Rust, shared memory (libnvram-rs)"
	select BR2_PACKAGE_HAS_LIBNVRAM
	select BR2_PACKAGE_HOST_RUSTC
	depends on BR2_PACKAGE_HOST_RUSTC_TARGET_ARCH_SUPPORTS
	help
	  Keeps the live store in a POSIX shared memory segment, so a
	  write is visible to every process immediately and disk writes
	  are deferred to nvram_commit() the way FreshTomato does. Returns
	  borrowed pointers the caller never frees, so NVRAM reads no
	  longer leak.

	  Requires rc to call nvram_init() once, after the nvram
	  partition is mounted: nothing else brings the segment up, and
	  until it does, calls read and write the files directly.

	  https://github.com/tomato64/libnvram-rs

comment "Rust libnvram needs a toolchain w/ host rustc support"
	depends on !BR2_PACKAGE_HOST_RUSTC_TARGET_ARCH_SUPPORTS

endchoice

config BR2_PACKAGE_HAS_LIBNVRAM
	bool

config BR2_PACKAGE_PROVIDES_LIBNVRAM
	string
	default "libnvram-c"      if BR2_PACKAGE_LIBNVRAM_C
	default "libnvram-rs"     if BR2_PACKAGE_LIBNVRAM_RS

endif
```

## tomato64/package/lvgl/Config.in
```kconfig
config BR2_PACKAGE_LVGL
	bool "lvgl"
	select BR2_PACKAGE_LIBDRM
	help
	  Light and Versatile Graphics Library, built for a Linux DRM
	  display as a static library staged for other packages to link
	  against. Carries the widgets, the DRM backend and the evdev
	  input.

	  Nothing is installed on the target: the library exists so
	  ucode-mod-lvgl can link it into lv.so.

	  https://lvgl.io/
```

## tomato64/package/mt7996app/Config.in
```kconfig
config BR2_PACKAGE_MT7996APP
	bool "mt7996app"
	depends on BR2_PACKAGE_HOST_RUSTC_TARGET_ARCH_SUPPORTS
	depends on BR2_TOOLCHAIN_HAS_THREADS # iw-openwrt
	select BR2_PACKAGE_HOST_RUSTC
	select BR2_PACKAGE_IW_OPENWRT
	help
	  Live dashboard daemon for MediaTek mt7996e (Wi-Fi 7) access
	  points. Shows per-link MLO station statistics, airtime,
	  traffic history, mt76 debugfs counters and a channel /
	  puncturing planner.

	  Reads iw, nl80211, hostapd_cli and
	  /sys/kernel/debug/ieee80211. Serves its own web UI with no
	  authentication on 127.0.0.1:8996 by default.

	  https://github.com/rmandrad/mt7996app
```

## tomato64/package/ucode-mod-lvgl/Config.in
```kconfig
config BR2_PACKAGE_UCODE_MOD_LVGL
	bool "ucode-mod-lvgl"
	select BR2_PACKAGE_LVGL
	select BR2_PACKAGE_UCODE
	select BR2_PACKAGE_LIBUBOX
	select BR2_PACKAGE_LIBDRM
	help
	  LVGL bound to ucode, so the front-panel UI can be written in
	  ucode rather than in C. Builds one file, lv.so, which ucode
	  loads as the module lv.

	  Carries the widgets, the DRM display and the evdev pointer,
	  and no fonts or artwork: those are loaded at run time from
	  files the application ships.

	  https://github.com/blogic/ucode-mod-lvgl
```
