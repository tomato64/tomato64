## tomato64/package/jsonpath/Config.in
```kconfig
config BR2_PACKAGE_JSONPATH
	bool "jsonpath"
	select BR2_PACKAGE_LIBUBOX
	select BR2_PACKAGE_JSON_C
	help
	  JSON parsing utility
```

## tomato64/package/libmssl/Config.in
```kconfig
config BR2_PACKAGE_LIBMSSL
	bool "libmssl"
	select BR2_PACKAGE_LIBSHARED
	select BR2_PACKAGE_OPENSSL
	help
	  httpd ssl helper library
```

## tomato64/package/libshared/Config.in
```kconfig
config BR2_PACKAGE_LIBSHARED
	bool "libshared"
	select BR2_PACKAGE_LIBNVRAM
	select BR2_PACKAGE_BUSYBOX
	help
	  libshared is a helper library for rc.
```

## tomato64/package/linux-firmware-openwrt/Config.in
```kconfig
config BR2_PACKAGE_LINUX_FIRMWARE_OPENWRT
	bool "linux-firmware-openwrt"
	help
	  This package provides various binary firmware files (closed
	  binary blobs) for such devices like LAN, WLAN cards etc.
```

## tomato64/package/mac80211/Config.in
```kconfig
config BR2_PACKAGE_MAC80211
	bool "mac80211"
	depends on BR2_aarch64
	help
	  Backport of mac80211
```

## tomato64/package/mdu/Config.in
```kconfig
config BR2_PACKAGE_MDU
	bool "DDNS Updater"
	select BR2_PACKAGE_LIBSHARED
	select BR2_PACKAGE_LIBNVRAM
	select BR2_PACKAGE_LIBCURL
	select BR2_PACKAGE_LIBCURL_FORCE_TLS
	select BR2_PACKAGE_LIBCURL_VERBOSE
	select BR2_PACKAGE_LIBCURL_PROXY_SUPPORT
	select BR2_PACKAGE_LIBCURL_COOKIES_SUPPORT
	select BR2_PACKAGE_LIBCURL_EXTRA_PROTOCOLS_FEATURES
	help
	  Tomato Dynamic DNS Update Utility
```

## tomato64/package/mediatek-bootloaders/Config.in
```kconfig
config BR2_PACKAGE_MEDIATEK_BOOTLOADERS
	bool "mediatek-bootloaders"
	help
	  Pre-compile mediatek bootloaders
```

## tomato64/package/mtd-openwrt/Config.in
```kconfig
config BR2_PACKAGE_MTD_OPENWRT
	bool "mtd-openwrt"
	select BR2_PACKAGE_LIBUBOX
	help
	  OpenWrt MTD utility for firmware flashing and TRX CRC repair.
```

## tomato64/package/nbfc-linux/Config.in
```kconfig
config BR2_PACKAGE_NBFC_LINUX
	bool "nbfc-linux"
	select BR2_PACKAGE_LM_SENSORS
	help
	  C port of Stefan Hirschmann's NoteBook FanControl
```

## tomato64/package/ndpi/Config.in
```kconfig
config BR2_PACKAGE_NDPI
	bool "ndpi-netfilter"
	help
	  Deep Packet Inspection netfilter kernel module
```

## tomato64/package/netifd/Config.in
```kconfig
config BR2_PACKAGE_NETIFD
	bool "netifd"
	select BR2_PACKAGE_LIBUBOX
	select BR2_PACKAGE_UBUS
	select BR2_PACKAGE_UDEBUG
	select BR2_PACKAGE_LIBUCI
	select BR2_PACKAGE_LIBNL_TINY
	help
	  OpenWrt network interface daemon
```

## tomato64/package/netsnmp-tomato/Config.in
```kconfig
config BR2_PACKAGE_NETSNMP_TOMATO
	bool "netsnmp"
	depends on BR2_USE_MMU # fork()
	help
	  Suite of applications used to implement SNMP v1, SNMP v2c, and
	  SNMP v3 using both IPv4 and IPv6.

	  http://net-snmp.sourceforge.net/
```

## tomato64/package/nocatsplash/Config.in
```kconfig
config BR2_PACKAGE_NOCATSPLASH
	bool "nocatsplash"
	select BR2_PACKAGE_LIBGLIB2
	help
	  NoCatSplash is a Open Public Network Gateway Daemon.
	  It performs as a [captive/open/active] portal.
```

## tomato64/package/nvram/Config.in
```kconfig
config BR2_PACKAGE_NVRAM
	bool "nvram cli"
	select BR2_PACKAGE_LIBSHARED
	select BR2_PACKAGE_LIBNVRAM
	help
	  userspace nvram cli command
```

## tomato64/package/openvpn_plugin_auth_nvram/Config.in
```kconfig
config BR2_PACKAGE_OPENVPN_PLUGIN_AUTH_NVRAM
	bool "openvpn_plugin_auth_nvram"
	select BR2_PACKAGE_LIBNVRAM
	help
	  OpenVPN username plugin.
```

## tomato64/package/openwrt-wifi/Config.in
```kconfig
config BR2_PACKAGE_OPENWRT_WIFI
	bool "openwrt-wifi"
	select BR2_PACKAGE_HOSTAPD_OPENWRT
	select BR2_PACKAGE_IW_OPENWRT
	select BR2_PACKAGE_IWINFO
	select BR2_PACKAGE_NETIFD
	select BR2_PACKAGE_JSONPATH
	select BR2_PACKAGE_RELAYD
	help
	  wireless-scripts taken from OpenWrt
```

## tomato64/package/others/Config.in
```kconfig
config BR2_PACKAGE_OTHERS
	bool "others"
	select BR2_PACKAGE_LIBSHARED
	help
	  A bunch of bash script programs
```

## tomato64/package/ovpn-dco/Config.in
```kconfig
config BR2_PACKAGE_OVPN_DCO
	bool "ovpn-dco"
	help
	  OpenVPN Data Channel Offload kernel module
```

## tomato64/package/pdureader/Config.in
```kconfig
config BR2_PACKAGE_PDUREADER
	bool "pdureader"
	help
	  Reader and parser of 2/3/4G modems SMS storage.
```

## tomato64/package/platform/Config.in
```kconfig
menuconfig BR2_PACKAGE_PLATFORM
	bool "platform"
	help
	  Target Platform

if BR2_PACKAGE_PLATFORM

config BR2_PACKAGE_PLATFORM_X86_64
	bool "x86_64"
	depends on BR2_x86_64

config BR2_PACKAGE_PLATFORM_ARM64
	bool
	depends on BR2_aarch64

config BR2_PACKAGE_PLATFORM_MEDIATEK
	bool

config BR2_PACKAGE_PLATFORM_MT6000
	bool "MT6000"
	depends on BR2_aarch64
	select BR2_PACKAGE_PLATFORM_ARM64
	select BR2_PACKAGE_PLATFORM_MEDIATEK

config BR2_PACKAGE_PLATFORM_BPIR3
	bool "BPIR3"
	depends on BR2_aarch64
	select BR2_PACKAGE_PLATFORM_ARM64
	select BR2_PACKAGE_PLATFORM_MEDIATEK

config BR2_PACKAGE_PLATFORM_BPIR3MINI
	bool "BPIR3MINI"
	depends on BR2_aarch64
	select BR2_PACKAGE_PLATFORM_ARM64
	select BR2_PACKAGE_PLATFORM_MEDIATEK

config BR2_PACKAGE_PLATFORM_RPI4
	bool "RPI4"
	depends on BR2_aarch64
	select BR2_PACKAGE_PLATFORM_ARM64
endif
```

## tomato64/package/pppd-tomato/Config.in
```kconfig
config BR2_PACKAGE_PPPD_TOMATO
	bool "pppd"
	depends on !BR2_STATIC_LIBS
	depends on BR2_USE_MMU
	select BR2_PACKAGE_OPENSSL if BR2_TOOLCHAIN_USES_GLIBC
	select BR2_PACKAGE_LIBOPENSSL_ENABLE_DES if BR2_PACKAGE_LIBOPENSSL
	help
	  An implementation of the Point-to-point protocol.

	  http://www.samba.org/ppp/

comment "pppd needs a toolchain w/ dynamic library"
	depends on BR2_STATIC_LIBS
	depends on BR2_USE_MMU
```

## tomato64/package/pptpd/Config.in
```kconfig
config BR2_PACKAGE_PPTPD
	bool "pptpd"
	select BR2_PACKAGE_PPPD_TOMATO
	help
	  PPTPD Server
```
