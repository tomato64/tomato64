## tomato64/configs/r6s_defconfig
```kconfig
BR2_aarch64=y
BR2_cortex_a76_a55=y
BR2_TOOLCHAIN_BUILDROOT_VENDOR="tomato64"
BR2_TOOLCHAIN_BUILDROOT_MUSL=y
BR2_PACKAGE_HOST_LINUX_HEADERS_CUSTOM_6_6=y
BR2_BINUTILS_VERSION_2_44_X=y
BR2_BINUTILS_GPROFNG=y
BR2_GCC_VERSION_15_X=y
BR2_TOOLCHAIN_BUILDROOT_CXX=y
BR2_GCC_ENABLE_OPENMP=y
BR2_DL_DIR="~/buildroot-src"
BR2_CCACHE=y
BR2_OPTIMIZE_3=y
BR2_GLOBAL_PATCH_DIR="$(BR2_EXTERNAL_TOMATO64_PATH)/patches/"
BR2_TARGET_GENERIC_HOSTNAME=""
BR2_TARGET_GENERIC_ISSUE=""
BR2_INIT_RC=y
BR2_ROOTFS_DEVICE_CREATION_DYNAMIC_EUDEV=y
BR2_ROOTFS_DEVICE_TABLE="$(BR2_EXTERNAL_TOMATO64_PATH)/board/common/device_table.txt"
# BR2_TARGET_ENABLE_ROOT_LOGIN is not set
# BR2_TARGET_GENERIC_GETTY is not set
# BR2_TARGET_GENERIC_REMOUNT_ROOTFS_RW is not set
BR2_ROOTFS_POST_BUILD_SCRIPT="$(BR2_EXTERNAL_TOMATO64_PATH)/board/arm64/r6s/post-build.sh"
BR2_ROOTFS_POST_IMAGE_SCRIPT="$(BR2_EXTERNAL_TOMATO64_PATH)/board/arm64/r6s/post-image.sh $(BR2_EXTERNAL_TOMATO64_PATH)/board/common/post-image-tar.sh"
BR2_ROOTFS_POST_IMAGE_SCRIPT_ARGS="r6s"
BR2_LINUX_KERNEL=y
BR2_LINUX_KERNEL_CUSTOM_VERSION=y
BR2_LINUX_KERNEL_CUSTOM_VERSION_VALUE="6.6.110"
BR2_LINUX_KERNEL_PATCH="$(BR2_EXTERNAL_TOMATO64_PATH)/board/arm64/r6s/linux-patches $(BR2_EXTERNAL_TOMATO64_PATH)/board/arm64/common/linux-patches"
BR2_LINUX_KERNEL_USE_CUSTOM_CONFIG=y
BR2_LINUX_KERNEL_CUSTOM_CONFIG_FILE="$(BR2_EXTERNAL_TOMATO64_PATH)/board/arm64/r6s/linux.config"
BR2_LINUX_KERNEL_ZSTD=y
BR2_LINUX_KERNEL_DTS_SUPPORT=y
BR2_LINUX_KERNEL_INTREE_DTS_NAME="rockchip/rk3588s-nanopi-r6s"
BR2_LINUX_KERNEL_NEEDS_HOST_OPENSSL=y
BR2_LINUX_KERNEL_NEEDS_HOST_LIBELF=y
BR2_PACKAGE_BUSYBOX_CONFIG="$(BR2_EXTERNAL_TOMATO64_PATH)/package/busybox/busybox.config"
BR2_PACKAGE_BINUTILS=y
BR2_PACKAGE_BINUTILS_TARGET=y
# BR2_PACKAGE_EUDEV_ENABLE_HWDB is not set
BR2_PACKAGE_ROCKCHIP_RKBIN=y
BR2_PACKAGE_ROCKCHIP_RKBIN_TPL_FILENAME="bin/rk35/rk3588_ddr_lp4_2112MHz_lp5_2400MHz_v1.16.bin"
BR2_PACKAGE_ROCKCHIP_RKBIN_BL31_FILENAME="bin/rk35/rk3588_bl31_v1.45.elf"
# BR2_PACKAGE_DROPBEAR_SMALL is not set
# BR2_PACKAGE_IFUPDOWN_SCRIPTS is not set
# BR2_PACKAGE_WIRELESS_TOOLS_IWCONFIG is not set
BR2_PACKAGE_FILE=y
BR2_PACKAGE_TMUX=y
BR2_TARGET_ROOTFS_EXT2=y
BR2_TARGET_ROOTFS_EXT2_4=y
BR2_TARGET_ROOTFS_EXT2_SIZE="665M"
BR2_TARGET_ROOTFS_TAR_ZSTD=y
BR2_TARGET_ROOTFS_TAR_OPTIONS="--exclude='./bkp' --exclude='./cifs1' --exclude='./cifs2' --exclude='./dev' --exclude='./etc' --exclude='./home' --exclude='./jffs' --exclude='./lib64' --exclude='./media' --exclude='./mmc' --exclude='./mnt' --exclude='./nas' --exclude='./nvram' --exclude='./opt' --exclude='./proc' --exclude='./root' --exclude='./sys' --exclude='./tftpboot' --exclude='./var'"
BR2_TARGET_UBOOT=y
BR2_TARGET_UBOOT_BUILD_SYSTEM_KCONFIG=y
BR2_TARGET_UBOOT_CUSTOM_VERSION=y
BR2_TARGET_UBOOT_CUSTOM_VERSION_VALUE="2024.10"
BR2_TARGET_UBOOT_PATCH="$(BR2_EXTERNAL_TOMATO64_PATH)/patches/uboot-rockchip"
BR2_TARGET_UBOOT_BOARD_DEFCONFIG="nanopi-r6s-rk3588s"
BR2_TARGET_UBOOT_NEEDS_PYLIBFDT=y
BR2_TARGET_UBOOT_NEEDS_PYELFTOOLS=y
BR2_TARGET_UBOOT_NEEDS_OPENSSL=y
BR2_TARGET_UBOOT_NEEDS_GNUTLS=y
BR2_TARGET_UBOOT_NEEDS_UTIL_LINUX=y
BR2_TARGET_UBOOT_NEEDS_ROCKCHIP_RKBIN=y
BR2_PACKAGE_HOST_GO_BIN=y
BR2_PACKAGE_PLATFORM_R6S=y
```

## tomato64/configs/rpi4_defconfig
```kconfig
BR2_aarch64=y
BR2_cortex_a72=y
BR2_ARM_FPU_VFPV4=y
BR2_TOOLCHAIN_BUILDROOT_VENDOR="tomato64"
BR2_TOOLCHAIN_BUILDROOT_MUSL=y
BR2_BINUTILS_VERSION_2_44_X=y
BR2_BINUTILS_GPROFNG=y
BR2_GCC_VERSION_14_X=y
BR2_TOOLCHAIN_BUILDROOT_CXX=y
BR2_GCC_ENABLE_OPENMP=y
BR2_DL_DIR="~/buildroot-src"
BR2_CCACHE=y
BR2_OPTIMIZE_3=y
BR2_GLOBAL_PATCH_DIR="$(BR2_EXTERNAL_TOMATO64_PATH)/patches/"
BR2_TARGET_GENERIC_HOSTNAME="Tomato64"
BR2_TARGET_GENERIC_ISSUE=""
BR2_INIT_RC=y
BR2_ROOTFS_DEVICE_CREATION_DYNAMIC_EUDEV=y
BR2_ROOTFS_DEVICE_TABLE="$(BR2_EXTERNAL_TOMATO64_PATH)/board/common/device_table.txt"
# BR2_TARGET_ENABLE_ROOT_LOGIN is not set
# BR2_TARGET_GENERIC_GETTY is not set
# BR2_TARGET_GENERIC_REMOUNT_ROOTFS_RW is not set
BR2_ROOTFS_POST_BUILD_SCRIPT="$(BR2_EXTERNAL_TOMATO64_PATH)/board/arm64/rpi4/post-build.sh"
BR2_ROOTFS_POST_IMAGE_SCRIPT="$(BR2_EXTERNAL_TOMATO64_PATH)/board/arm64/rpi4/post-image.sh $(BR2_EXTERNAL_TOMATO64_PATH)/board/common/post-image-tar.sh"
BR2_ROOTFS_POST_IMAGE_SCRIPT_ARGS="rpi4"
BR2_LINUX_KERNEL=y
BR2_LINUX_KERNEL_CUSTOM_VERSION=y
BR2_LINUX_KERNEL_CUSTOM_VERSION_VALUE="6.6.106"
BR2_PACKAGE_HOST_LINUX_HEADERS_CUSTOM_6_6=y
BR2_LINUX_KERNEL_PATCH="$(BR2_EXTERNAL_TOMATO64_PATH)/board/arm64/rpi4/linux-patches"
BR2_LINUX_KERNEL_USE_CUSTOM_CONFIG=y
BR2_LINUX_KERNEL_CUSTOM_CONFIG_FILE="$(BR2_EXTERNAL_TOMATO64_PATH)/board/arm64/rpi4/linux.config"
BR2_LINUX_KERNEL_ZSTD=y
BR2_LINUX_KERNEL_DTS_SUPPORT=y
BR2_LINUX_KERNEL_INTREE_DTS_NAME="broadcom/bcm2711-rpi-4-b"
BR2_LINUX_KERNEL_NEEDS_HOST_OPENSSL=y
BR2_LINUX_KERNEL_NEEDS_HOST_LIBELF=y
BR2_PACKAGE_BUSYBOX_CONFIG="$(BR2_EXTERNAL_TOMATO64_PATH)/package/busybox/busybox.config"
BR2_PACKAGE_BINUTILS=y
BR2_PACKAGE_BINUTILS_TARGET=y
# BR2_PACKAGE_EUDEV_ENABLE_HWDB is not set
# BR2_PACKAGE_DROPBEAR_SMALL is not set
# BR2_PACKAGE_IFUPDOWN_SCRIPTS is not set
# BR2_PACKAGE_WIRELESS_TOOLS_IWCONFIG is not set
BR2_PACKAGE_RPI_FIRMWARE=y
BR2_PACKAGE_RPI_FIRMWARE_VARIANT_PI4=y
BR2_PACKAGE_RPI_FIRMWARE_CONFIG_FILE="$(BR2_EXTERNAL_TOMATO64_PATH)/board/arm64/rpi4/config_4_64bit.txt"
BR2_PACKAGE_RPI_FIRMWARE_CMDLINE_FILE="$(BR2_EXTERNAL_TOMATO64_PATH)/board/arm64/rpi4/cmdline.txt"
BR2_PACKAGE_FILE=y
BR2_PACKAGE_TMUX=y
BR2_TARGET_ROOTFS_EXT2=y
BR2_TARGET_ROOTFS_EXT2_4=y
BR2_TARGET_ROOTFS_EXT2_SIZE="650M"
BR2_TARGET_ROOTFS_TAR_ZSTD=y
BR2_TARGET_ROOTFS_TAR_OPTIONS="--exclude='./bkp' --exclude='./cifs1' --exclude='./cifs2' --exclude='./dev' --exclude='./etc' --exclude='./home' --exclude='./jffs' --exclude='./lib64' --exclude='./media' --exclude='./mmc' --exclude='./mnt' --exclude='./nas' --exclude='./nvram' --exclude='./opt' --exclude='./proc' --exclude='./root' --exclude='./sys' --exclude='./tftpboot' --exclude='./var'"
BR2_PACKAGE_HOST_GO_BIN=y
BR2_PACKAGE_PLATFORM_RPI4=y
BR2_PACKAGE_HOST_DOSFSTOOLS=y
BR2_PACKAGE_HOST_GENIMAGE=y
BR2_PACKAGE_HOST_KMOD_XZ=y
#BR2_PACKAGE_HOST_MTOOLS=y
BR2_PACKAGE_BRCMFMAC_SDIO_FIRMWARE_RPI=y
BR2_PACKAGE_BRCMFMAC_SDIO_FIRMWARE_RPI_WIFI=y
```

## tomato64/configs/tomato64_defconfig
```kconfig
BR2_x86_64=y
BR2_x86_x86_64_v2=y
BR2_TOOLCHAIN_BUILDROOT_VENDOR="tomato64"
BR2_TOOLCHAIN_BUILDROOT_MUSL=y
BR2_BINUTILS_VERSION_2_42_X=y
BR2_BINUTILS_GPROFNG=y
BR2_GCC_VERSION_14_X=y
BR2_TOOLCHAIN_BUILDROOT_CXX=y
BR2_GCC_ENABLE_OPENMP=y
BR2_DL_DIR="~/buildroot-src"
BR2_CCACHE=y
BR2_OPTIMIZE_3=y
BR2_GLOBAL_PATCH_DIR="$(BR2_EXTERNAL_TOMATO64_PATH)/patches/"
BR2_TARGET_GENERIC_HOSTNAME=""
BR2_TARGET_GENERIC_ISSUE=""
BR2_INIT_RC=y
BR2_ROOTFS_DEVICE_CREATION_DYNAMIC_EUDEV=y
BR2_ROOTFS_DEVICE_TABLE="$(BR2_EXTERNAL_TOMATO64_PATH)/board/x86_64/device_table.txt"
# BR2_TARGET_ENABLE_ROOT_LOGIN is not set
# BR2_TARGET_GENERIC_GETTY is not set
# BR2_TARGET_GENERIC_REMOUNT_ROOTFS_RW is not set
BR2_ROOTFS_OVERLAY="$(BR2_EXTERNAL_TOMATO64_PATH)/board/x86_64/overlay/"
BR2_ROOTFS_POST_BUILD_SCRIPT="$(BR2_EXTERNAL_TOMATO64_PATH)/board/x86_64/post-build.sh"
BR2_ROOTFS_POST_IMAGE_SCRIPT="$(BR2_EXTERNAL_TOMATO64_PATH)/board/x86_64/post-image-efi.sh $(BR2_EXTERNAL_TOMATO64_PATH)/board/x86_64/post-image-tar.sh $(BR2_EXTERNAL_TOMATO64_PATH)/board/x86_64/post-image-iso.sh"
BR2_LINUX_KERNEL=y
BR2_LINUX_KERNEL_CUSTOM_VERSION=y
BR2_LINUX_KERNEL_CUSTOM_VERSION_VALUE="6.9.11"
BR2_LINUX_KERNEL_USE_CUSTOM_CONFIG=y
BR2_LINUX_KERNEL_CUSTOM_CONFIG_FILE="$(BR2_EXTERNAL_TOMATO64_PATH)/board/x86_64/linux.config"
BR2_LINUX_KERNEL_ZSTD=y
BR2_LINUX_KERNEL_INSTALL_TARGET=y
BR2_LINUX_KERNEL_NEEDS_HOST_OPENSSL=y
BR2_LINUX_KERNEL_NEEDS_HOST_LIBELF=y
BR2_PACKAGE_BUSYBOX_CONFIG="$(BR2_EXTERNAL_TOMATO64_PATH)/package/busybox/busybox.config"
BR2_PACKAGE_BINUTILS=y
BR2_PACKAGE_BINUTILS_TARGET=y
BR2_PACKAGE_LINUX_FIRMWARE=y
# BR2_PACKAGE_EUDEV_ENABLE_HWDB is not set
BR2_PACKAGE_INTEL_MICROCODE=y
# BR2_PACKAGE_INTEL_MICROCODE_INSTALL_TARGET is not set
# BR2_PACKAGE_DROPBEAR_SMALL is not set
# BR2_PACKAGE_IFUPDOWN_SCRIPTS is not set
# BR2_PACKAGE_WIRELESS_TOOLS_IWCONFIG is not set
BR2_PACKAGE_FILE=y
BR2_PACKAGE_TMUX=y
BR2_TARGET_ROOTFS_CPIO=y
BR2_TARGET_ROOTFS_CPIO_ZSTD=y
BR2_TARGET_ROOTFS_EXT2=y
BR2_TARGET_ROOTFS_EXT2_4=y
BR2_TARGET_ROOTFS_EXT2_SIZE="2048M"
BR2_TARGET_ROOTFS_EXT2_MKFS_OPTIONS="-O 64bit,^metadata_csum_seed"
BR2_TARGET_ROOTFS_TAR_ZSTD=y
BR2_TARGET_ROOTFS_TAR_OPTIONS="--exclude='./bkp' --exclude='./cifs1' --exclude='./cifs2' --exclude='./dev' --exclude='./etc' --exclude='./home' --exclude='./jffs' --exclude='./lib64' --exclude='./media' --exclude='./mmc' --exclude='./mnt' --exclude='./nas' --exclude='./nvram' --exclude='./opt' --exclude='./proc' --exclude='./root' --exclude='./sys' --exclude='./tftpboot' --exclude='./var'"
BR2_TARGET_GRUB2=y
BR2_TARGET_GRUB2_I386_EFI=y
BR2_TARGET_GRUB2_X86_64_EFI=y
BR2_TARGET_GRUB2_BUILTIN_MODULES_EFI="boot linux ext2 fat squash4 part_msdos part_gpt normal efi_gop all_video efi_uga video_bochs video_cirrus part_gpt gfxterm gfxmenu jpeg png search search_label search_fs_uuid search_fs_file"
BR2_TARGET_SYSLINUX=y
BR2_PACKAGE_HOST_XORRISO=y
```

## tomato64/configs/tomato64_iso_defconfig
```kconfig
BR2_x86_64=y
BR2_x86_x86_64_v2=y
BR2_TOOLCHAIN_BUILDROOT_VENDOR="tomato64"
BR2_TOOLCHAIN_BUILDROOT_MUSL=y
BR2_BINUTILS_VERSION_2_39_X=y
BR2_BINUTILS_GPROFNG=y
BR2_GCC_VERSION_12_X=y
BR2_TOOLCHAIN_BUILDROOT_CXX=y
BR2_GCC_ENABLE_OPENMP=y
BR2_DL_DIR="~/buildroot-src"
BR2_CCACHE=y
BR2_OPTIMIZE_3=y
BR2_GLOBAL_PATCH_DIR="$(BR2_EXTERNAL_TOMATO64_PATH)/patches/"
BR2_TARGET_GENERIC_HOSTNAME=""
BR2_TARGET_GENERIC_ISSUE=""
BR2_INIT_RC=y
BR2_ROOTFS_DEVICE_CREATION_DYNAMIC_EUDEV=y
BR2_ROOTFS_DEVICE_TABLE="$(BR2_EXTERNAL_TOMATO64_PATH)/board/x86_64/device_table.txt"
# BR2_TARGET_ENABLE_ROOT_LOGIN is not set
# BR2_TARGET_GENERIC_GETTY is not set
# BR2_TARGET_GENERIC_REMOUNT_ROOTFS_RW is not set
BR2_ROOTFS_OVERLAY="$(BR2_EXTERNAL_TOMATO64_PATH)/board/x86_64/overlay/"
BR2_ROOTFS_POST_BUILD_SCRIPT="$(BR2_EXTERNAL_TOMATO64_PATH)/board/x86_64/post-build-iso.sh"
BR2_LINUX_KERNEL=y
BR2_LINUX_KERNEL_USE_CUSTOM_CONFIG=y
BR2_LINUX_KERNEL_CUSTOM_CONFIG_FILE="$(BR2_EXTERNAL_TOMATO64_PATH)/board/x86_64/linux.config"
BR2_LINUX_KERNEL_ZSTD=y
BR2_LINUX_KERNEL_INSTALL_TARGET=y
BR2_LINUX_KERNEL_NEEDS_HOST_OPENSSL=y
BR2_LINUX_KERNEL_NEEDS_HOST_LIBELF=y
BR2_PACKAGE_BUSYBOX_CONFIG="$(BR2_EXTERNAL_TOMATO64_PATH)/package/busybox/busybox.config"
BR2_PACKAGE_GDB=y
BR2_PACKAGE_GDB_DEBUGGER=y
BR2_PACKAGE_GDB_TUI=y
BR2_PACKAGE_STRACE=y
BR2_PACKAGE_BINUTILS=y
BR2_PACKAGE_BINUTILS_TARGET=y
BR2_PACKAGE_LINUX_FIRMWARE=y
BR2_PACKAGE_LINUX_FIRMWARE_RTL_8169=y
# BR2_PACKAGE_EUDEV_ENABLE_HWDB is not set
BR2_PACKAGE_CA_CERTIFICATES=y
BR2_PACKAGE_MARIADB=y
# BR2_PACKAGE_DROPBEAR_SMALL is not set
BR2_PACKAGE_ETHTOOL=y
# BR2_PACKAGE_IFUPDOWN_SCRIPTS is not set
BR2_PACKAGE_FILE=y
BR2_PACKAGE_TMUX=y
BR2_PACKAGE_HTOP=y
BR2_TARGET_ROOTFS_EXT2=y
BR2_TARGET_ROOTFS_EXT2_4=y
BR2_TARGET_ROOTFS_EXT2_SIZE="550M"
BR2_TARGET_ROOTFS_ISO9660=y
# BR2_TARGET_ROOTFS_TAR is not set
BR2_TARGET_GRUB2=y
BR2_TARGET_GRUB2_BOOT_PARTITION="cd"
BR2_TARGET_GRUB2_BUILTIN_MODULES_PC="boot linux ext2 fat squash4 part_msdos part_gpt normal biosdisk iso9660"
```

## tomato64/package/accel-pptp/Config.in
```kconfig
config BR2_PACKAGE_ACCEL_PPTP
	bool "accel-pptp"
	select BR2_PACKAGE_PPPD_TOMATO
	help
	  accel-pptp for tomato
```

## tomato64/package/apcupsd-tomato/Config.in
```kconfig
config BR2_PACKAGE_APCUPSD_TOMATO
	bool "apcupsd"
	depends on BR2_INSTALL_LIBSTDCPP
	depends on BR2_TOOLCHAIN_HAS_THREADS
	depends on BR2_TOOLCHAIN_GCC_AT_LEAST_4_9 # libusb
	depends on BR2_USE_MMU # fork()
	select BR2_PACKAGE_LIBUSB
	select BR2_PACKAGE_LIBUSB_COMPAT
	help
	  A daemon for controlling APC UPSes.

	  http://www.apcupsd.org/

comment "apcupsd needs a toolchain w/ C++, threads, gcc >= 4.9"
	depends on BR2_USE_MMU
	depends on !BR2_INSTALL_LIBSTDCPP || !BR2_TOOLCHAIN_HAS_THREADS || !BR2_TOOLCHAIN_GCC_AT_LEAST_4_9
```

## tomato64/package/avahi-tomato/Config.in
```kconfig
config BR2_PACKAGE_AVAHI_TOMATO
	bool "avahi"
	# libdaemon uses fork()
	depends on BR2_USE_MMU
	depends on BR2_TOOLCHAIN_HAS_THREADS
	depends on !BR2_STATIC_LIBS
	select BR2_PACKAGE_LIBDAEMON
	select BR2_PACKAGE_EXPAT
	help
	  Avahi is a system which facilitates service
	  discovery on a local network.

	  http://www.avahi.org/

comment "avahi needs a toolchain w/ threads"
	depends on BR2_USE_MMU
	depends on !BR2_TOOLCHAIN_HAS_THREADS
```

## tomato64/package/comgt-tomato/Config.in
```kconfig
config BR2_PACKAGE_COMGT_TOMATO
	bool "gcom"
	help
	  comgt is a scripting language interpreter useful for establishing communications on serial lines and through PCMCIA modems as well as GPRS and 3G datacards.
```

## tomato64/package/cstats/Config.in
```kconfig
config BR2_PACKAGE_CSTATS
	bool "iptraffic"
	select BR2_PACKAGE_LIBSHARED
	help
	  MOnitors bandwidth by IP.
```

## tomato64/package/dhcpv6-opnsense/Config.in
```kconfig
config BR2_PACKAGE_DHCPV6_OPNSENSE
	bool "dhcpv6-opnsense"
	select BR2_PACKAGE_LIBSHARED
	select BR2_PACKAGE_LIBNVRAM
	help
	  WIDE-DHCPv6 client (dhcp6c) based on the actively maintained
	  OPNsense fork, with Tomato64 nvram/GUI integration.

	  Drop-in replacement for the legacy "dhcpv6" (dhcpv6-tomato)
	  package. Uses the same /etc/dhcp6c.conf format and the same
	  command-line interface (including -T LL|LLT DUID type selection,
	  restored on top of the upstream fork), so no rc/GUI changes are
	  required. Provides /usr/sbin/dhcp6c.
```

## tomato64/package/dhcpv6-tomato/Config.in
```kconfig
config BR2_PACKAGE_DHCPV6_TOMATO
	bool "dhcpv6"
	select BR2_PACKAGE_LIBSHARED
	select BR2_PACKAGE_LIBNVRAM
	help
	  dhcpv6 client for toamto firmware
```

## tomato64/package/dnscrypt-proxy/Config.in
```kconfig
config BR2_PACKAGE_DNSCRYPT_PROXY
	bool "dnscrypt"
	select BR2_PACKAGE_LIBSODIUM
	select BR2_PACKAGE_LIBSODIUM_FULL
	help
	  Encrypted DNS
```

## tomato64/package/fan2go/Config.in
```kconfig
config BR2_PACKAGE_FAN2GO
	bool "fan2go"
	depends on BR2_x86_64
	select BR2_PACKAGE_LM_SENSORS
	help
	  A simple daemon providing dynamic fan speed control based on temperature sensors.
```

## tomato64/package/fstools/Config.in
```kconfig
config BR2_PACKAGE_FSTOOLS
	bool "fstools"
	depends on BR2_aarch64
	select BR2_PACKAGE_LIBUBOX
	select BR2_PACKAGE_UTIL_LINUX_LIBBLKID
	help
	  OpenWrt filesystem utilities
```

## tomato64/package/fullconenat/Config.in
```kconfig
config BR2_PACKAGE_FULLCONENAT
	bool "fullconenat"
	depends on BR2_LINUX_KERNEL
	select BR2_PACKAGE_IPTABLES
	help
	  RFC3489-compatible full cone NAT for netfilter.

	  Builds the xt_FULLCONENAT kernel module, which turns
	  MASQUERADE into full cone SNAT. Only UDP traffic gets true
	  full-cone behaviour; for other protocols FULLCONENAT is
	  equivalent to MASQUERADE.

	  https://github.com/llccd/netfilter-full-cone-nat

comment "fullconenat needs a Linux kernel to be built"
	depends on !BR2_LINUX_KERNEL
```

## tomato64/package/fwtool/Config.in.host
```kconfig
config BR2_PACKAGE_HOST_FWTOOL
	bool "host fwtool"
	help
	  Utility for appending and extracting firmware metadata and signatures
```

## tomato64/package/hostapd-openwrt/Config.in
```kconfig
config BR2_PACKAGE_HOSTAPD_OPENWRT
	bool "hostapd-openwrt"
	depends on BR2_USE_MMU # fork()
	select BR2_PACKAGE_LIBOPENSSL_ENABLE_DES if BR2_PACKAGE_LIBOPENSSL
	select BR2_PACKAGE_LIBOPENSSL_ENABLE_MD4 if BR2_PACKAGE_LIBOPENSSL
	select BR2_PACKAGE_UCODE
	select BR2_PACKAGE_UDEBUG
	select BR2_PACKAGE_LIBNL_TINY
	help
	  User space daemon for wireless access points.

	  It implements IEEE 802.11 access point management,
	  IEEE 802.1X/WPA/WPA2/EAP authenticators, RADIUS client,
	  EAP server and RADIUS authentication server.

	  http://w1.fi/hostapd/
```

## tomato64/package/hotplug2/Config.in
```kconfig
config BR2_PACKAGE_HOTPLUG2
	bool "hotplug2"
	select BR2_PACKAGE_UDEVTRIGGER
	help
	  Tomato uevent helper
```
