## tomato64/Config.in
```kconfig
comment "Core Components"
source "$BR2_EXTERNAL_TOMATO64_PATH/package/rc/Config.in"
source "$BR2_EXTERNAL_TOMATO64_PATH/package/skeleton-init-rc/Config.in"
source "$BR2_EXTERNAL_TOMATO64_PATH/package/httpd/Config.in"
source "$BR2_EXTERNAL_TOMATO64_PATH/package/rstats/Config.in"
source "$BR2_EXTERNAL_TOMATO64_PATH/package/cstats/Config.in"
source "$BR2_EXTERNAL_TOMATO64_PATH/package/wanuptime/Config.in"
source "$BR2_EXTERNAL_TOMATO64_PATH/package/hotplug2/Config.in"
source "$BR2_EXTERNAL_TOMATO64_PATH/package/udevtrigger/Config.in"
source "$BR2_EXTERNAL_TOMATO64_PATH/package/libmssl/Config.in"
source "$BR2_EXTERNAL_TOMATO64_PATH/package/rom/Config.in"
source "$BR2_EXTERNAL_TOMATO64_PATH/package/others/Config.in"
source "$BR2_EXTERNAL_TOMATO64_PATH/package/www/Config.in"
source "$BR2_EXTERNAL_TOMATO64_PATH/package/nvram/Config.in"
source "$BR2_EXTERNAL_TOMATO64_PATH/package/libshared/Config.in"
source "$BR2_EXTERNAL_TOMATO64_PATH/package/libnvram/Config.in"
source "$BR2_EXTERNAL_TOMATO64_PATH/package/miniupnpd/Config.in"
source "$BR2_EXTERNAL_TOMATO64_PATH/package/rp-pppoe-tomato/Config.in"
source "$BR2_EXTERNAL_TOMATO64_PATH/package/pppd-tomato/Config.in"
source "$BR2_EXTERNAL_TOMATO64_PATH/package/virt-what/Config.in"
source "$BR2_EXTERNAL_TOMATO64_PATH/package/ndpi/Config.in"
source "$BR2_EXTERNAL_TOMATO64_PATH/package/tomato64-helper-scripts/Config.in"
source "$BR2_EXTERNAL_TOMATO64_PATH/package/mac80211/Config.in"
source "$BR2_EXTERNAL_TOMATO64_PATH/package/mt76/Config.in"
source "$BR2_EXTERNAL_TOMATO64_PATH/package/fwtool/Config.in.host"
source "$BR2_EXTERNAL_TOMATO64_PATH/package/ucode/Config.in"
source "$BR2_EXTERNAL_TOMATO64_PATH/package/udebug/Config.in"
source "$BR2_EXTERNAL_TOMATO64_PATH/package/libnl-tiny/Config.in"
source "$BR2_EXTERNAL_TOMATO64_PATH/package/netifd/Config.in"
source "$BR2_EXTERNAL_TOMATO64_PATH/package/hostapd-openwrt/Config.in"
source "$BR2_EXTERNAL_TOMATO64_PATH/package/iw-openwrt/Config.in"
source "$BR2_EXTERNAL_TOMATO64_PATH/package/iwinfo/Config.in"
source "$BR2_EXTERNAL_TOMATO64_PATH/package/jsonpath/Config.in"
source "$BR2_EXTERNAL_TOMATO64_PATH/package/openwrt-wifi/Config.in"
source "$BR2_EXTERNAL_TOMATO64_PATH/package/t64up/Config.in"
source "$BR2_EXTERNAL_TOMATO64_PATH/package/platform/Config.in"
comment "Configurable Components"
source "$BR2_EXTERNAL_TOMATO64_PATH/package/sd-idle/Config.in"
source "$BR2_EXTERNAL_TOMATO64_PATH/package/mdu/Config.in"
source "$BR2_EXTERNAL_TOMATO64_PATH/package/dnscrypt-proxy/Config.in"
source "$BR2_EXTERNAL_TOMATO64_PATH/package/stubby/Config.in"
source "$BR2_EXTERNAL_TOMATO64_PATH/package/openvpn_plugin_auth_nvram/Config.in"
source "$BR2_EXTERNAL_TOMATO64_PATH/package/tinc11/Config.in"
source "$BR2_EXTERNAL_TOMATO64_PATH/package/minidlna-tomato/Config.in"
source "$BR2_EXTERNAL_TOMATO64_PATH/package/nbfc-linux/Config.in"
source "$BR2_EXTERNAL_TOMATO64_PATH/package/netsnmp-tomato/Config.in"
source "$BR2_EXTERNAL_TOMATO64_PATH/package/vsftpd-tomato/Config.in"
source "$BR2_EXTERNAL_TOMATO64_PATH/package/pptpd/Config.in"
source "$BR2_EXTERNAL_TOMATO64_PATH/package/samba4-tomato/Config.in"
source "$BR2_EXTERNAL_TOMATO64_PATH/package/wsdd2/Config.in"
source "$BR2_EXTERNAL_TOMATO64_PATH/package/avahi-tomato/Config.in"
source "$BR2_EXTERNAL_TOMATO64_PATH/package/nginx-tomato/Config.in"
source "$BR2_EXTERNAL_TOMATO64_PATH/package/php-tomato/Config.in"
source "$BR2_EXTERNAL_TOMATO64_PATH/package/dhcpv6-tomato/Config.in"
source "$BR2_EXTERNAL_TOMATO64_PATH/package/comgt-tomato/Config.in"
source "$BR2_EXTERNAL_TOMATO64_PATH/package/nocatsplash/Config.in"
source "$BR2_EXTERNAL_TOMATO64_PATH/package/apcupsd-tomato/Config.in"
source "$BR2_EXTERNAL_TOMATO64_PATH/package/wg-quick-posix/Config.in"
source "$BR2_EXTERNAL_TOMATO64_PATH/package/zfs-tomato/Config.in"
```

## tomato64/configs/bcm53xx_defconfig
```kconfig
BR2_arm=y
BR2_cortex_a9=y
BR2_TOOLCHAIN_BUILDROOT_VENDOR="tomato64"
BR2_TOOLCHAIN_BUILDROOT_MUSL=y
BR2_PACKAGE_HOST_LINUX_HEADERS_CUSTOM_6_12=y
BR2_BINUTILS_VERSION_2_45_X=y
BR2_BINUTILS_GPROFNG=y
BR2_GCC_VERSION_15_X=y
BR2_TOOLCHAIN_BUILDROOT_CXX=y
BR2_GCC_ENABLE_OPENMP=y
BR2_DL_DIR="~/buildroot-src"
BR2_CCACHE=y
BR2_OPTIMIZE_3=y
BR2_GLOBAL_PATCH_DIR="$(BR2_EXTERNAL_TOMATO64_PATH)/patches/"
BR2_TARGET_GENERIC_HOSTNAME=""
BR2_TARGET_GENERIC_ISSUE=""
BR2_INIT_RC=y
BR2_ROOTFS_DEVICE_CREATION_DYNAMIC_EUDEV=y
BR2_ROOTFS_DEVICE_TABLE="$(BR2_EXTERNAL_TOMATO64_PATH)/board/common/device_table.txt"
# BR2_TARGET_ENABLE_ROOT_LOGIN is not set
# BR2_TARGET_GENERIC_GETTY is not set
# BR2_TARGET_GENERIC_REMOUNT_ROOTFS_RW is not set
BR2_ROOTFS_POST_BUILD_SCRIPT="$(BR2_EXTERNAL_TOMATO64_PATH)/board/arm/bcm53xx/post-build.sh"
BR2_ROOTFS_POST_IMAGE_SCRIPT="$(BR2_EXTERNAL_TOMATO64_PATH)/board/arm/bcm53xx/post-image.sh $(BR2_EXTERNAL_TOMATO64_PATH)/board/common/post-image-tar.sh"
BR2_ROOTFS_POST_IMAGE_SCRIPT_ARGS="bcm53xx"
BR2_LINUX_KERNEL=y
BR2_LINUX_KERNEL_CUSTOM_VERSION=y
BR2_LINUX_KERNEL_CUSTOM_VERSION_VALUE="$(TOMATO64_KERNEL_VERSION)"
BR2_LINUX_KERNEL_PATCH="$(BR2_EXTERNAL_TOMATO64_PATH)/board/arm/bcm53xx/linux-patches $(BR2_EXTERNAL_TOMATO64_PATH)/board/common/linux-patches"
BR2_LINUX_KERNEL_USE_CUSTOM_CONFIG=y
BR2_LINUX_KERNEL_CUSTOM_CONFIG_FILE="$(BR2_EXTERNAL_TOMATO64_PATH)/board/arm/bcm53xx/linux.config"
BR2_LINUX_KERNEL_DTS_SUPPORT=y
BR2_LINUX_KERNEL_INTREE_DTS_NAME="broadcom/bcm4708-asus-rt-ac56u broadcom/bcm4708-asus-rt-ac68u broadcom/bcm4708-buffalo-wzr-1750dhp broadcom/bcm4708-linksys-ea6300-v1 broadcom/bcm4708-linksys-ea6500-v2 broadcom/bcm4708-netgear-r6250 broadcom/bcm4708-netgear-r6300-v2 broadcom/bcm47081-asus-rt-n18u broadcom/bcm47081-buffalo-wzr-600dhp2 broadcom/bcm47081-buffalo-wzr-900dhp broadcom/bcm4709-asus-rt-ac3200 broadcom/bcm4709-asus-rt-ac87u broadcom/bcm4709-buffalo-wxr-1900dhp broadcom/bcm4709-linksys-ea9200 broadcom/bcm4709-netgear-r7000 broadcom/bcm4709-netgear-r7900 broadcom/bcm4709-netgear-r8000 broadcom/bcm4709-tplink-archer-c9-v1 broadcom/bcm47094-asus-rt-ac3100 broadcom/bcm47094-asus-rt-ac5300 broadcom/bcm47094-asus-rt-ac88u broadcom/bcm47094-dlink-dir-885l broadcom/bcm47094-dlink-dir-890l broadcom/bcm47094-linksys-panamera broadcom/bcm47094-netgear-r8500 broadcom/bcm47094-phicomm-k3 broadcom/bcm53016-dlink-dwl-8610ap"
BR2_LINUX_KERNEL_NEEDS_HOST_OPENSSL=y
BR2_LINUX_KERNEL_NEEDS_HOST_LIBELF=y
BR2_PACKAGE_BUSYBOX_CONFIG="$(BR2_EXTERNAL_TOMATO64_PATH)/package/busybox/busybox.config"
BR2_PACKAGE_BINUTILS=y
BR2_PACKAGE_BINUTILS_TARGET=y
# BR2_PACKAGE_EUDEV_ENABLE_HWDB is not set
BR2_PACKAGE_JPEG_TURBO=y
# BR2_PACKAGE_DROPBEAR_SMALL is not set
# BR2_PACKAGE_IFUPDOWN_SCRIPTS is not set
# BR2_PACKAGE_WIRELESS_TOOLS_IWCONFIG is not set
BR2_PACKAGE_FILE=y
BR2_PACKAGE_TMUX=y
BR2_TARGET_ROOTFS_SQUASHFS=y
# BR2_TARGET_ROOTFS_SQUASHFS_PAD is not set
BR2_TARGET_ROOTFS_SQUASHFS4_XZ=y
BR2_TARGET_ROOTFS_TAR_ZSTD=y
BR2_TARGET_ROOTFS_TAR_OPTIONS="--exclude='./bkp' --exclude='./cifs1' --exclude='./cifs2' --exclude='./dev' --exclude='./etc' --exclude='./home' --exclude='./jffs' --exclude='./lib64' --exclude='./media' --exclude='./mmc' --exclude='./mnt' --exclude='./nas' --exclude='./nvram' --exclude='./opt' --exclude='./proc' --exclude='./root' --exclude='./sys' --exclude='./tftpboot' --exclude='./var'"
BR2_PACKAGE_HOST_MTD=y
# BR2_PACKAGE_RC_DOCKER is not set
BR2_PACKAGE_PLATFORM_BCM53XX=y
```

## tomato64/configs/bpi-r3_defconfig
```kconfig
BR2_aarch64=y
BR2_TOOLCHAIN_BUILDROOT_VENDOR="tomato64"
BR2_TOOLCHAIN_BUILDROOT_MUSL=y
BR2_PACKAGE_HOST_LINUX_HEADERS_CUSTOM_6_12=y
BR2_BINUTILS_VERSION_2_44_X=y
BR2_BINUTILS_GPROFNG=y
BR2_GCC_VERSION_15_X=y
BR2_TOOLCHAIN_BUILDROOT_CXX=y
BR2_GCC_ENABLE_OPENMP=y
BR2_DL_DIR="~/buildroot-src"
BR2_CCACHE=y
BR2_OPTIMIZE_3=y
BR2_GLOBAL_PATCH_DIR="$(BR2_EXTERNAL_TOMATO64_PATH)/patches/"
BR2_TARGET_GENERIC_HOSTNAME=""
BR2_TARGET_GENERIC_ISSUE=""
BR2_INIT_RC=y
BR2_ROOTFS_DEVICE_CREATION_DYNAMIC_EUDEV=y
BR2_ROOTFS_DEVICE_TABLE="$(BR2_EXTERNAL_TOMATO64_PATH)/board/common/device_table.txt"
# BR2_TARGET_ENABLE_ROOT_LOGIN is not set
# BR2_TARGET_GENERIC_GETTY is not set
# BR2_TARGET_GENERIC_REMOUNT_ROOTFS_RW is not set
BR2_ROOTFS_POST_BUILD_SCRIPT="$(BR2_EXTERNAL_TOMATO64_PATH)/board/arm64/bpir3/post-build.sh"
BR2_ROOTFS_POST_IMAGE_SCRIPT="$(BR2_EXTERNAL_TOMATO64_PATH)/board/arm64/bpir3/post-image.sh $(BR2_EXTERNAL_TOMATO64_PATH)/board/common/post-image-tar.sh"
BR2_ROOTFS_POST_IMAGE_SCRIPT_ARGS="bpi-r3"
BR2_LINUX_KERNEL=y
BR2_LINUX_KERNEL_CUSTOM_VERSION=y
BR2_LINUX_KERNEL_CUSTOM_VERSION_VALUE="6.12.63"
BR2_LINUX_KERNEL_PATCH="$(BR2_EXTERNAL_TOMATO64_PATH)/board/arm64/common/linux-patches-mt $(BR2_EXTERNAL_TOMATO64_PATH)/board/common/linux-patches"
BR2_LINUX_KERNEL_USE_CUSTOM_CONFIG=y
BR2_LINUX_KERNEL_CUSTOM_CONFIG_FILE="$(BR2_EXTERNAL_TOMATO64_PATH)/board/arm64/common/mediatek/linux.config"
BR2_LINUX_KERNEL_ZSTD=y
BR2_LINUX_KERNEL_DTS_SUPPORT=y
BR2_LINUX_KERNEL_INTREE_DTS_NAME="mediatek/mt7986a-bananapi-bpi-r3"
BR2_LINUX_KERNEL_INTREE_DTSO_NAMES="mediatek/mt7986a-bananapi-bpi-r3-nor mediatek/mt7986a-bananapi-bpi-r3-nand mediatek/mt7986a-bananapi-bpi-r3-emmc mediatek/mt7986a-bananapi-bpi-r3-sd mediatek/mt7986a-bananapi-bpi-r3-respeaker-2mics"
BR2_LINUX_KERNEL_NEEDS_HOST_OPENSSL=y
BR2_LINUX_KERNEL_NEEDS_HOST_LIBELF=y
BR2_PACKAGE_BUSYBOX_CONFIG="$(BR2_EXTERNAL_TOMATO64_PATH)/package/busybox/busybox.config"
BR2_PACKAGE_BINUTILS=y
BR2_PACKAGE_BINUTILS_TARGET=y
# BR2_PACKAGE_EUDEV_ENABLE_HWDB is not set
# BR2_PACKAGE_DROPBEAR_SMALL is not set
# BR2_PACKAGE_IFUPDOWN_SCRIPTS is not set
# BR2_PACKAGE_WIRELESS_TOOLS_IWCONFIG is not set
BR2_PACKAGE_FILE=y
BR2_PACKAGE_TMUX=y
BR2_TARGET_ROOTFS_EXT2=y
BR2_TARGET_ROOTFS_EXT2_4=y
BR2_TARGET_ROOTFS_EXT2_SIZE="710M"
BR2_TARGET_ROOTFS_TAR_ZSTD=y
BR2_TARGET_ROOTFS_TAR_OPTIONS="--exclude='./bkp' --exclude='./cifs1' --exclude='./cifs2' --exclude='./dev' --exclude='./etc' --exclude='./home' --exclude='./jffs' --exclude='./lib64' --exclude='./media' --exclude='./mmc' --exclude='./mnt' --exclude='./nas' --exclude='./nvram' --exclude='./opt' --exclude='./proc' --exclude='./root' --exclude='./sys' --exclude='./tftpboot' --exclude='./var'"
BR2_TARGET_ARM_TRUSTED_FIRMWARE=y
BR2_TARGET_ARM_TRUSTED_FIRMWARE_CUSTOM_GIT=y
BR2_TARGET_ARM_TRUSTED_FIRMWARE_CUSTOM_REPO_URL="https://github.com/mtk-openwrt/arm-trusted-firmware.git"
BR2_TARGET_ARM_TRUSTED_FIRMWARE_CUSTOM_REPO_VERSION="78a0dfd927bb00ce973a1f8eb4079df0f755887a"
BR2_TARGET_ARM_TRUSTED_FIRMWARE_PLATFORM="mt7986"
BR2_TARGET_ARM_TRUSTED_FIRMWARE_ADDITIONAL_TARGETS="PLAT=mt7986 BOOT_DEVICE=sdmmc USE_MKIMAGE=1 DRAM_USE_DDR4=1 BOARD_BGA=1 HAVE_DRAM_OBJ_FILE=yes"
BR2_TARGET_ARM_TRUSTED_FIRMWARE_IMAGES="bl2.img bl31.bin "
BR2_TARGET_ARM_TRUSTED_FIRMWARE_NEEDS_DTC=y
BR2_TARGET_ARM_TRUSTED_FIRMWARE_NEEDS_UBOOT_MKIMAGE=y
BR2_TARGET_UBOOT=y
BR2_TARGET_UBOOT_BUILD_SYSTEM_KCONFIG=y
BR2_TARGET_UBOOT_CUSTOM_VERSION=y
BR2_TARGET_UBOOT_CUSTOM_VERSION_VALUE="2025.10"
BR2_TARGET_UBOOT_PATCH="$(BR2_EXTERNAL_TOMATO64_PATH)/patches/uboot-mediatek"
BR2_TARGET_UBOOT_BOARD_DEFCONFIG="mt7986a_bpi-r3-sd"
BR2_TARGET_UBOOT_NEEDS_GNUTLS=y
BR2_TARGET_UBOOT_NEEDS_XXD=y
BR2_TARGET_UBOOT_NEEDS_ATF_BL31=y
BR2_PACKAGE_HOST_GO_BIN=y
BR2_PACKAGE_MEDIATEK_BOOTLOADERS=y
BR2_PACKAGE_PLATFORM_BPIR3=y
```

## tomato64/configs/mt6000_defconfig
```kconfig
BR2_aarch64=y
BR2_TOOLCHAIN_BUILDROOT_VENDOR="tomato64"
BR2_TOOLCHAIN_BUILDROOT_MUSL=y
BR2_PACKAGE_HOST_LINUX_HEADERS_CUSTOM_6_6=y
BR2_BINUTILS_VERSION_2_44_X=y
BR2_BINUTILS_GPROFNG=y
BR2_GCC_VERSION_15_X=y
BR2_TOOLCHAIN_BUILDROOT_CXX=y
BR2_GCC_ENABLE_OPENMP=y
BR2_DL_DIR="~/buildroot-src"
BR2_CCACHE=y
BR2_OPTIMIZE_3=y
BR2_GLOBAL_PATCH_DIR="$(BR2_EXTERNAL_TOMATO64_PATH)/patches/"
BR2_TARGET_GENERIC_HOSTNAME=""
BR2_TARGET_GENERIC_ISSUE=""
BR2_INIT_RC=y
BR2_ROOTFS_DEVICE_CREATION_DYNAMIC_EUDEV=y
BR2_ROOTFS_DEVICE_TABLE="$(BR2_EXTERNAL_TOMATO64_PATH)/board/common/device_table.txt"
# BR2_TARGET_ENABLE_ROOT_LOGIN is not set
# BR2_TARGET_GENERIC_GETTY is not set
# BR2_TARGET_GENERIC_REMOUNT_ROOTFS_RW is not set
BR2_ROOTFS_POST_BUILD_SCRIPT="$(BR2_EXTERNAL_TOMATO64_PATH)/board/arm64/mt6000/post-build.sh"
BR2_ROOTFS_POST_IMAGE_SCRIPT="$(BR2_EXTERNAL_TOMATO64_PATH)/board/arm64/mt6000/post-image.sh $(BR2_EXTERNAL_TOMATO64_PATH)/board/common/post-image-tar.sh"
BR2_LINUX_KERNEL=y
BR2_LINUX_KERNEL_CUSTOM_VERSION=y
BR2_LINUX_KERNEL_CUSTOM_VERSION_VALUE="6.6.110"
BR2_LINUX_KERNEL_PATCH="$(BR2_EXTERNAL_TOMATO64_PATH)/board/arm64/common/linux-patches"
BR2_LINUX_KERNEL_USE_CUSTOM_CONFIG=y
BR2_LINUX_KERNEL_CUSTOM_CONFIG_FILE="$(BR2_EXTERNAL_TOMATO64_PATH)/board/arm64/mt6000/linux.config"
BR2_LINUX_KERNEL_ZSTD=y
BR2_LINUX_KERNEL_DTS_SUPPORT=y
BR2_LINUX_KERNEL_INTREE_DTS_NAME="mediatek/mt7986a-glinet-gl-mt6000"
BR2_LINUX_KERNEL_NEEDS_HOST_OPENSSL=y
BR2_LINUX_KERNEL_NEEDS_HOST_LIBELF=y
BR2_PACKAGE_BUSYBOX_CONFIG="$(BR2_EXTERNAL_TOMATO64_PATH)/package/busybox/busybox.config"
BR2_PACKAGE_BINUTILS=y
BR2_PACKAGE_BINUTILS_TARGET=y
# BR2_PACKAGE_EUDEV_ENABLE_HWDB is not set
# BR2_PACKAGE_DROPBEAR_SMALL is not set
# BR2_PACKAGE_IFUPDOWN_SCRIPTS is not set
# BR2_PACKAGE_WIRELESS_TOOLS_IWCONFIG is not set
BR2_PACKAGE_FILE=y
BR2_PACKAGE_TMUX=y
BR2_TARGET_ROOTFS_EXT2=y
BR2_TARGET_ROOTFS_EXT2_4=y
BR2_TARGET_ROOTFS_EXT2_SIZE="650M"
BR2_TARGET_ROOTFS_TAR_ZSTD=y
BR2_TARGET_ROOTFS_TAR_OPTIONS="--exclude='./bkp' --exclude='./cifs1' --exclude='./cifs2' --exclude='./dev' --exclude='./etc' --exclude='./home' --exclude='./jffs' --exclude='./lib64' --exclude='./media' --exclude='./mmc' --exclude='./mnt' --exclude='./nas' --exclude='./nvram' --exclude='./opt' --exclude='./proc' --exclude='./root' --exclude='./sys' --exclude='./tftpboot' --exclude='./var'"
BR2_PACKAGE_HOST_GO_BIN=y
BR2_PACKAGE_PLATFORM_MT6000=y
```
