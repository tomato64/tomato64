## tomato64/package/httpd/Config.in
```kconfig
config BR2_PACKAGE_HTTPD
	bool "tomato httpd server"
	select BR2_PACKAGE_LIBSHARED
	select BR2_PACKAGE_LIBMSSL
	help
	  Tomato httpd Server
```

## tomato64/package/iw-openwrt/Config.in
```kconfig
config BR2_PACKAGE_IW_OPENWRT
	bool "iw-openwrt"
	depends on BR2_TOOLCHAIN_HAS_THREADS # libnl
	select BR2_PACKAGE_LIBNL_TINY
	help
	  Utility for wireless devices using the mac80211 kernel stack

	  https://wireless.wiki.kernel.org/en/users/documentation/iw

comment "iw-openwrt needs a toolchain w/ threads"
	depends on !BR2_TOOLCHAIN_HAS_THREADS
```

## tomato64/package/iwinfo/Config.in
```kconfig
config BR2_PACKAGE_IWINFO
	bool "iwinfo"
	help
	  Wireless information library with simplified API for nl80211
	  and wext driver interfaces.
```
